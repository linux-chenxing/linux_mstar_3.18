## drivers/mstar/watchdog/Kconfig
```kconfig
config MS_WATCHDOG
        tristate "watchdog driver"
	depends on ARCH_INFINITY
        help
          Say Y here to enable the driver for the watchdog.

          If unsure, say Y.

          To compile this driver as a module, choose M here: the
          module will be called mdrv_wdt.
```

## drivers/mstar2/drv/alsa_audio_driver/Kconfig
```kconfig
# drivers/mstar/drv/alsa_audio_driver/Kconfig

menuconfig MSTAR_ALSA_AUDIO_DRIVER
	tristate "ALSA Audio Driver"
	default n
	depends on SND
	help
		MStar ALSA Audio Driver.

		Note!
		Before enable "MStar ASLA Audio Driver",
		be remembered to enable "Linux ALSA Kernel Module" first,
		and enable the required modules then.

		[Device Driver]->[Sound card support]->[Advanced Linux Sound Architecture]->...

if MSTAR_ALSA_AUDIO_DRIVER

config MSTAR_ALSA_AUDIO_DRIVER_DRV
	tristate "ALSA Audio Driver - DRV Layer"
	default m
	depends on MSTAR_ALSA_AUDIO_DRIVER
	help
		MStar ALSA Audio Driver - DRV Layer.

config MSTAR_ALSA_AUDIO_DRIVER_HAL
	tristate "ALSA Audio Driver - HAL Layer"
	default m
	depends on MSTAR_ALSA_AUDIO_DRIVER_DRV
	help
		MStar ALSA Audio Driver - HAL Layer.

endif #MSTAR_ALSA_AUDIO_DRIVER
```

## drivers/mstar2/drv/bdma/Kconfig
```kconfig
config MSTAR_BDMA
bool "Mstar BDMA Feature"
default n

---help---
    To enable or to disable Mstar dynamic voltage and frequency scaling mechanism
```

## drivers/mstar2/drv/clkm/Kconfig
```kconfig
config MSTAR_CLKM

tristate "MSTAR Clock Manager"

help
    MStar clock manager driver
default n
    
```

## drivers/mstar2/drv/dvfs/Kconfig
```kconfig
config MSTAR_DVFS
bool "Mstar Dynamic Voltage and Frequency Scaling"
depends on CPU_FREQ
default n

---help---
    To enable or to disable Mstar dynamic voltage and frequency scaling mechanism

config MSTAR_DVFS_FIXED_CPU_CLOCK
bool "Enable Fixed CPU Clock Mechanism"
depends on MSTAR_DVFS
default n

---help---
    To enable or to disable fixed CPU clock mechanism


config MSTAR_DVFS_BOOT_TIME_MANUAL
bool "Enable DVFS Boot time manual setting"
depends on MSTAR_DVFS
default n

---help---
    To enable or to disable DVFS Boot time manual setting

config DVFS_BOOT_MODE_TIME
    int "Mstar DVFS boot time"
    depends on MSTAR_DVFS_BOOT_TIME_MANUAL
    default 30
    range 0 100
---help---
    Adjustment boot time value



config MSTAR_DVFS_KERNEL_IIC
bool "DVFS using kernel mode IIC"
depends on MSTAR_DVFS
default n

---help---
    Select if DVFS using kernel mode IIC
```

## drivers/mstar2/drv/flash/Kconfig
```kconfig
config MSTAR_SPI_FLASH

  select MTD
  select MTD_CHAR
  select MTD_BLKDEVS
  select NFTL
  select NFTL_RW
  select MTD_OOPS
  
  select MTD_COMPLEX_MAPPINGS
  select MTD_BLOCK2MTD
  select MTD_CMDLINE_PARTS
  select SCSI_LOWLEVEL
  select AUTOFS_FS
  
  select FAT_FS
  select MSDOS_FS
  select VFAT_FS
  
  select MTD_DEBUG
  #select MTD_DEBUG_VERBOSE
  select MTD_CONCAT
  select MTD_PARTITIONS
  #select MTD_NAND
  #select JFFS2_FS
  #select JFFS2_FS_DEBUG
  #select JFFS2_FS_WRITEBUFFER

tristate "SPI Flash"
default n

---help---
Enable compilation option for driver SPI Flash.
	
menu "SPI_ACCESS_MODE"

choice
	prompt "READ"
	default DUAL_READ
config RIUISP
 bool "RIU ISP"
config NORMAL_READ
	bool "single-read"
config BURST_READ
	bool "burst-read"
config DUAL_READ
	bool "dual-read"
config QUAL_READ
	bool "qual-read"

endchoice

endmenu

menu "SPI_WRITE_SELECTION"

choice
	prompt "WRITE"
	default REMOVE_WRITE_PROTECT
config REMOVE_WRITE_PROTECT
 bool "remove-write-protect(speed up)"
config ADD_WRITE_PROTECT
	bool "add-write-protect"

endchoice

endmenu	
```

## drivers/mstar2/drv/fusion/Kconfig
```kconfig
config MSTAR_FUSION
	tristate "Fusion"
	---help---
	  Fusion is the IPC API used by DirectFB and FusionSound.
config FUSION_FOR_ANDROID_VERSION_BIGGER_THAN_5.0
        bool "Fusion (For ANDROID Version > 5.0)"
        default n
```

## drivers/mstar2/drv/fusion_9_03/Kconfig
```kconfig
config MSTAR_FUSION_9_03
	tristate "Fusion9.0.3"
	---help---
	  Fusion is the IPC API used by DirectFB and FusionSound.
```

## drivers/mstar2/drv/graphic/Kconfig
```kconfig
config MSTAR_GRAPHIC
tristate "GRAPHIC"
default n
help
    enable MStar GRAPHIC driver.
```

## drivers/mstar2/drv/ipa_pool/Kconfig
```kconfig
config MSTAR_IPAPOOL
bool  "IPA POOL"
depends on CMA 
select MSTAR_MIU
default n
 
help
    MStar IPA POOL driver function
    
```

## drivers/mstar2/drv/ipanic/Kconfig
```kconfig
config IPANIC
	tristate "ipanic"
	default n 
	help
		dump all kernel and userspace info to external storage device when kernel panic
```

## drivers/mstar2/drv/ldm/Kconfig
```kconfig
choice
	prompt "Mstar Local Dimming"
	depends on HAS_LDM
	default HAS_LD_DMA_MODE

config HAS_LD
	bool "Local Dimming normal mode"
	depends on HAS_LDM
	help
	    enable MStar local dimming driver.
	    
config HAS_LD_DMA_MODE
	bool "Local Dimming DMA mode"
	depends on HAS_LDM
	help
		enable MStar local dimming DMA driver.
endchoice
```

## drivers/mstar2/drv/nand/Kconfig
```kconfig
config MSTAR_NAND
  select MTD
  select MTD_BLKDEVS
  select MTD_OOPS

  select MTD_NAND_PLATFORM
  select MTD_CMDLINE_PARTS
  select MTD_UBI

  select MTD_NAND
  
  tristate "NAND"
  default n

help
    Enable MSTAR FCIE NAND driver

config MTD_SLC_WRITE
  bool "MTD Write/Read SLC partition"
  depends on MSTAR_NAND	
  default n
  help   
    Support Write/Read SLC Partition
    
config MSTAR_NAND_CHK_VERSION
  tristate "MStar NAND driver - check version"
  depends on MSTAR_NAND
  help
    MStar NAND driver - check version.    
config MSTAR_UNFD_BLK
	bool "mstar unfd ftl block device interface"
    depends on MSTAR_NAND
	default n
	help
		Enable Mstar unfd_FTL block device interface
```

## drivers/mstar2/drv/pcmcia/Kconfig
```kconfig
config MSTAR_PCMCIA
depends on MEDIA_SUPPORT
depends on DVB_CORE

tristate "PCMCIA"
default n

---help---
Enable compilation option for driver PCMCIA
```

## drivers/mstar2/drv/pwm/Kconfig
```kconfig
config MSTAR_PWM


tristate "PWM"
default y

---help---
Enable compilation option for driver PWM
```

## drivers/mstar2/drv/sdio/Kconfig
```kconfig
config MSTAR_SDIO_HOST
	bool "SD sdio host driver"
	depends on MMC
	default n
	---help---
		enable sdio host to support SD card

config MSTAR_SDIO_CARD_DETECT
	bool "card detection support"
	depends on MSTAR_SDIO_HOST
	default y
	---help---
		enable card detection for sdio host

config MSTAR_SDIO_WRITE_PROTECT
	bool "write protect support"
	depends on MSTAR_SDIO_HOST
	default n
	---help---
		enable write protect detection for sdio host
```

## drivers/mstar2/drv/sdmmc/Kconfig
```kconfig
config MSTAR_SDMMC
	bool "Mstar SD/MMC Card Interface Support"
	depends on MMC
	default n
	---help---
        Enable SD/MMC Driver Support for MStar Product


config MSTAR_SDMMC_TCARD
	bool "Mstar SD/MMC T-Flash Card Using"
	depends on MSTAR_SDMMC
	default n
  ---help---
        For T-Flash Socket, We don't use WP Pin


config MSTAR_SDMMC1_MAXCLK
    int "Mstar SD/MMC1 Maximum Clock"
    depends on MSTAR_SDMMC
    default 32000000
    range 300000 50000000
    ---help---
      The maximun Clock of SDMMC1

config MSTAR_SDMMC2_MAXCLK
    int "Mstar SD/MMC2 Maximum Clock"
    depends on MSTAR_SDMMC
    default 32000000
    range 300000 50000000
    ---help---
      The maximun Clock of SDMMC2

config MSTAR_SDMMC1_HOTP
	bool "Mstar SD/MMC1 Hotplug Support"
	depends on MSTAR_SDMMC
	default n
  ---help---
        For SD1, Whether we need to run hotplug funciton (HW consideration)


config MSTAR_SDMMC2_HOTP
	bool "Mstar SD/MMC2 Hotplug Support"
	depends on MSTAR_SDMMC
	default n
  ---help---
        For SD2, Whether we need to run hotplug funciton (HW consideration)

config MSTAR_SDMMC1_WP
	bool "Mstar SD/MMC1 Write Protect Support"
	depends on MSTAR_SDMMC
	default n
  ---help---
        For SD1, write protect pin detection


config MSTAR_SDMMC2_WP
	bool "Mstar SD/MMC2 Write Protect Support"
	depends on MSTAR_SDMMC
	default n
  ---help---
        For SD2, write protect pin detection

config MSTAR_SDMMC1_FAKECDZ
	bool "Mstar SD/MMC1 Fake CDZ"
	depends on !MSTAR_SDMMC1_HOTP && MSTAR_SDMMC
	default n
  ---help---
        For SD1, Whether we need to assume card detection always true (HW consideration)

config MSTAR_SDMMC2_FAKECDZ
	bool "Mstar SD/MMC2 Fake CDZ"
	depends on !MSTAR_SDMMC2_HOTP && MSTAR_SDMMC
	default n
  ---help---
        For SD2, Whether we need to assume card detection always true (HW consideration)

config MSTAR_SDMMC_DUALCARDS
	bool "FCIE & SDIO connect to SD card & SDIO device"
	depends on MSTAR_SDMMC
	default n
  ---help---
        For SD card & WiFi module work at the same time
```

## drivers/mstar2/drv/timer2/Kconfig
```kconfig
config MSTAR_TIMER2

tristate "MSTAR_TIMER2"

help
    MStar timer2 driver function
```

## drivers/mstar2/drv/utopia2k_str/Kconfig
```kconfig
config MSTAR_UTOPIA2K_STR

tristate "UTOPIA2K_STR"
default n
help
    MStar Utopia2K STR driver function
    
```

## drivers/mstar2/drv/xc/Kconfig
```kconfig
config MSTAR_XC
tristate "XC"
default n
help
    enable MStar XC driver.

config MSTAR_FRC_SOFTWARE_TOGGLE
tristate "FRC software interrupt toggle"
default n
help
    enable MStar FRC software interrupt toggle.


config MSTAR_XC_HDR_SUPPORT
bool "XC HDR Support"
default n
help
    enable MStar XC HDR Support
```

## drivers/net/wireless/mt7601U/Kconfig
```kconfig
config MT7601U
    tristate "MT7601 USB Wireless device support"
    depends on CFG80211 && USB
    select WIRELESS_EXT
    select WEXT_PRIV
    
```

## drivers/usb/pd/Kconfig
```kconfig
config TCPC_CLASS
	bool "TypeC Port Controller Device Class"
	help
	  Say Y to enable
	  Typec Port
	  Controller Device
	  Class

config TCPC_RT1711H
	bool "Richtek RT1711H TypeC port Controller Driver"
	depends on TCPC_CLASS
	default n
	help
	  Say Y to enable
	  Richtek RT1711H
	  TypeC port Controller
	  Driver
```
