## mstar2/drv/cma_pool/Kconfig
```kconfig
config MSTAR_CMAPOOL
bool  "CMA POOL"
depends on CMA
select MSTAR_MIU
 
help
    MStar CMA POOL driver function

config MSTAR_MIUSLITS
bool  "MIU SLITS"
depends on MSTAR_CMAPOOL 
select MSTAR_MIU
default n

help
    CMA HEAP kernel protected by MIU SLits
    
```

## mstar2/drv/cpupm/Kconfig
```kconfig
config MSTAR_CPUPM

tristate "MSTAR Cpu Power Manager"

help
    MStar cpu power manager manager driver
default n
    
```

## mstar2/drv/emac/Kconfig
```kconfig
config MSTAR_EMAC
select NET
select NET_ETHERNET
select MII
select PACKET
select USE_POLICY_FWD
select INET
select NETDEVICES

tristate "EMAC"
default y

---help---
Enable compilation option for driver EMAC

if MSTAR_EMAC
config MSTAR_EMAC_V3
bool "EMAC V3"
default n
help
    EMAC Experimental driver. K6, K6lite support

if MSTAR_EMAC_V3
choice
    prompt "Select RX Method"
    default EMAC_RX_Memory_Copy

config EMAC_RX_Memory_Copy
bool "Memory_Copy"
default n
help
    Use memcpy and additional RX buffer for RX callback function

config EMAC_RX_DMA
bool "DMA"
default n
help
    EMAC Direct access Kernel Memory in RX callback function.
    K6, K6lite can only use one MIU for kernel Memory.

endchoice

config EMAC_RX_NAPI
bool "Enable RX_NAPI"
default n
help
    Enable NAPI Method. Disable interrupt during heavy tracffic.

config EMAC_RX_NAPI_WEIGHT
int "RX_NAPI_WEIGHT"
default 64
depends on EMAC_RX_NAPI
help
    NAPI Weight

config EMAC_RX_GRO
bool "Enable RX_GRO"
default n
depends on EMAC_RX_NAPI
help
    Enable Generic receive offload. Merge packet with same destination and source

config EMAC_RX_DELAY_INTERRUPT
bool "Enable RX Delay Interrupt"
default y
help
    Enable RX Delay Interrupt. Reduce interrupt number.

if EMAC_RX_DELAY_INTERRUPT
config EMAC_DELAY_INTERRUPT_NUMBER
int "Packet Threshold"
default 64
help
    MAX 255

config EMAC_DELAY_INTERRUPT_TIMEOUT
int "Timeout"
default 6
help
    MAX 255

endif

choice
    prompt "Select TX Method"
    default EMAC_TX_Memory_Copy


config EMAC_TX_Memory_Copy
bool "Memory_Copy"
default n
help
    Use memcpy and additional TX buffer for TX callback function

config EMAC_TX_DMA
bool "DMA"
default n
depends on MSTAR_K6Lite
help
    EMAC Direct access Kernel Memory in TX callback function.

endchoice

choice
    prompt "Select TX Queue"
    default EMAC_TX_DESC_MODE if MSTAR_K6Lite
    default EMAC_NEW_TX_QUEUE if MSTAR_K6
    default EMAC_TX_4_QUEUE

config EMAC_TX_4_QUEUE
bool "Default TX Queue"
default n
help
    Use default TX Queue 4.

config EMAC_NEW_TX_QUEUE
bool "Enable Additional New TX Queue"
default n
depends on (MSTAR_K6Lite || MSTAR_K6) && !EMAC_10T_RANDOM_WAVEFORM
help
    Enable New TX Queue. Larger TX Queue.

config EMAC_TX_DESC_MODE
bool "Enable TX descriptor Mode"
default n
depends on MSTAR_K6Lite && !EMAC_10T_RANDOM_WAVEFORM
help
    Enable TX dexcriptor Mode. Use DRAM for TX QUEUE. K6lite support

endchoice

config EMAC_NEW_TX_QUEUE_THRESHOLD
int "New TX Queue Threshold"
default 60
depends on EMAC_NEW_TX_QUEUE
help
    MAX 63

config EMAC_TX_DESC_NUMBER
int "TX descriptor number"
default 240
depends on EMAC_TX_DESC_MODE
help
    MAX 1024


config EMAC_10T_RANDOM_WAVEFORM
bool "EMAC 10T random waveform test"
depends on MSTAR_K6Lite
default n
help
    Use ethtool to control 10T random waveform test

endif

config EMAC_SUPPLY_RNG
bool "Supply to random number generator device"
default n
help
    Supply to random number generator device

config ETHERNET_ALBANY
bool "Supply to internel PHY"
default n
help
    Supply to internel PHY

config MSTAR_HW_TX_CHECKSUM
bool "Supply to hardware TX checksum"
default n
help
    Supply to hardware TX checksum
    
config K3_RX_SWPATCH
bool "Supply to K3 RX SW Patch"
default n
help
    Supply to K3 RX frame drop due to padding 4 bytes issue

config DISCONNECT_DELAY_S
int "Disconnect delay in second"
default 1
help
    Disconnect delay in second

config MSTAR_EEE
bool "Supply to EEE function"
default n
help
    Supply to EEE function

config MSTAR_EMAC_NAPI
bool "Supply to EMAC NAPI"
default n
help
    Supply to EMAC NAPI

config EMAC_EPHY_LPA_FORCE_SPEED
bool "Link speed patch for link partner with force speed mode"
default n
help
    Patch for link speed detection when link partner is with force speed mode

config EMAC_PHY_RESTART_AN
bool "PHY restart anto-nego patch"
default n
help
    Patch to avoid auto-nego fail while doing stress for restarting system

config EMAC_RX_SPEED_LIMIT
bool "Enable Rx speed limit feature"
default n
help
    Enable Rx speed limit feature

endif
```

## mstar2/drv/env_handler/Kconfig
```kconfig
config MSTAR_ENABLE_ENV_HANDLER
        bool "Enable env handler"
help
    Enable mstar env handler driver function
default y


config MSTAR_ENV_HANDLER_1
        string "Env handler"
depends on MSTAR_ENABLE_ENV_HANDLER    
help
    MStar Env handler driver function
default MBOOT

config MSTAR_ENV_HANDLER_2
        string "Env handler"
depends on MSTAR_ENABLE_ENV_HANDLER    
help
    MStar Env handler driver function
default MPOOL
```

## mstar2/drv/fcie/Kconfig
```kconfig
config MSTAR_FCIE_HOST
	bool "SD fcie host driver"
	depends on MMC
	default n
	---help---
		enable fcie host to support SD card

config MSTAR_FCIE_CARD_DETECT
	bool "card detection support"
	depends on MSTAR_FCIE_HOST
	default y
	---help---
		enable card detection for fcie host

config MSTAR_FCIE_WRITE_PROTECT
	bool "write protect support"
	depends on MSTAR_FCIE_HOST
	default n
	---help---
		enable write protect detection for fcie host
```

## mstar2/drv/gmac/Kconfig
```kconfig
config MSTAR_GMAC
select NET
select NET_ETHERNET
select MII
select PACKET
select USE_POLICY_FWD
select INET
select NETDEVICES

tristate "GMAC"
default n

---help---
Enable compilation option for driver GMAC

if MSTAR_GMAC
config MSTAR_GMAC_V3
bool "GMAC V3"
default n
help
    GMAC Experimental driver. K6, K6lite, K7 support

if MSTAR_GMAC_V3
choice
    prompt "Select Interface"
    default GMAC_TO_RGMII
	depends on MSTAR_K6Lite || MSTAR_K6

config GMAC_TO_RGMII
bool "RGMII"
default n
help
    Use RGMII for GPHY

config GMAC_TO_RMII
bool "RMII"
default n
help
    Use RMII for EPHY

endchoice

choice
    prompt "Select RX Method"
    default GMAC_Memory_Copy

config GMAC_RX_Memory_Copy
bool "Memory_Copy"
default n
help
    Use memcpy and additional RX buffer for RX callback function

config GMAC_RX_DMA
bool "DMA"
default n
help
    GMAC Direct access Kernel Memory in RX callback function.
    K6, K6lite, k7 can only use one MIU for kernel Memory.

endchoice

config GMAC_RX_NAPI
bool "Enable RX_NAPI"
default y
help
    Enable NAPI Method. Disable interrupt during heavy tracffic.

if GMAC_RX_NAPI
config GMAC_RX_NAPI_WEIGHT
int "RX_NAPI_WEIGHT"
default 64
help
    NAPI Weight

config GMAC_RX_GRO
bool "Enable RX_GRO"
default y
help
    Enable Generic receive offload. Merge packet with same destination and source

endif

config GMAC_RX_DELAY_INTERRUPT
bool "Enable RX Delay Interrupt"
default y
help
    Enable RX Delay Interrupt. Reduce interrupt number.

if GMAC_RX_DELAY_INTERRUPT
config GMAC_DELAY_INTERRUPT_NUMBER
int "Packet Threshold"
default 1
help
    MAX 255

config GMAC_DELAY_INTERRUPT_TIMEOUT
int "Timeout"
default 1
help
    MAX 255

endif

choice
    prompt "Select TX Queue"
    default GMAC_TX_4_QUEUE

config GMAC_TX_4_QUEUE
bool "Default TX Queue"
default n
help
    Use default TX Queue 4.

config GMAC_NEW_TX_QUEUE_V3
bool "Enable Additional New TX Queue"
default n
help
    Enable New TX Queue. Larger TX Queue. Kayla support

config GMAC_TX_DESC_MODE
bool "Enable TX dexcriptor Mode"
default n
help
    Enable TX dexcriptor Mode. Use DRAM for TX QUEUE.

endchoice

if GMAC_NEW_TX_QUEUE_V3
config GMAC_NEW_TX_QUEUE_THRESHOLD_V3
int "New TX Queue Threshold"
default 60
help
    MAX 63

endif

endif

config MSTAR_GMAC_V2
bool "GMAC V2"
default n
help
    GMAC V2 architecture. Zero memcpy in RX, pre-allocate ring buffer

if MSTAR_GMAC_V2
config GMAC_RX_CMA
bool "Support RX skb allocated from CMA buffer"
default n
help
    Support RX skb allocated from CMA buffer

config GMAC_TX_ENHANCEMENT
bool "Select TX enhancement"
default n
help
    Select TX enhancement

if GMAC_TX_ENHANCEMENT

choice
    prompt "TX enhancement select"
    default GMAC_NEW_TX_QUEUE

config GMAC_NEW_TX_QUEUE
bool "Use new TX queue hardware design"
default n
help
    Use new TX queue hardware design, it's now supported on K6.

if GMAC_NEW_TX_QUEUE
config GMAC_NEW_TX_QUEUE_THRESHOLD
int "New TX queue threshold"
default 60
help
    New TX queue threshold
endif

config GMAC_TX_ZERO_COPY_SW_QUEUE
bool "Support TX zero copy with software queue"
default n
help
    Support TX zero copy with software queue

endchoice

endif

config GMAC_ISR_BOTTOM_HALF
bool "Support ISR bottom-half"
default n
help
    Support ISR bottom-half

if GMAC_ISR_BOTTOM_HALF

choice
    prompt "GMAC ISR BH select"
    default GMAC_ISR_BH_NAPI

config GMAC_ISR_BH_TASKLET
bool "Use tasklet for bottom-half"
default n
help
    Use tasklet for bottom-half

config GMAC_ISR_BH_NAPI
bool "Use NAPI for bottom-half"
default n
help
    Use NAPI for bottom-half

if GMAC_ISR_BH_NAPI
config GMAC_NAPI_WEIGHT
int "NAPI weight"
default 64
help
    NAPI weight

config GMAC_NAPI_GRO
bool "Use NAPI GRO mechanism"
default n
help
    Use NAPI GRO mechanism
endif

endchoice

endif
endif

config GMAC_SUPPLY_RNG
bool "Supply to random number generator device"
default n
help
    Supply to random number generator device

config GMAC_ETHERNET_ALBANY
bool "Supply to internel PHY"
default n
help
    Supply to internel PHY

config MSTAR_GMAC_HW_TX_CHECKSUM
bool "Supply to hardware TX checksum"
default n
help
    Supply to hardware TX checksum

config MSTAR_GMAC_JUMBO_PACKET
bool "Supply to jumbo packet"
default n
help
    Supply to jumbo packet
    
config MSTAR_GMAC_RMII_DOWNGRADE_MODE
bool "Supply GMAC to use external EPHY by RMII"
default y
help
    Supply to GMAC use external RMII EPHY
endif
```

## mstar2/drv/ir/Kconfig
```kconfig
config MSTAR_IR

tristate "IrDA"

help
    Titania IrDA driver function

#===================================================
# FANTASY PROTOCOL
#===================================================
if MSTAR_IR

config MSTAR_IR_FANTASY_MODE
  bool "Support fantasy protocol"
  default n
  help
    Support fantasy protocol

config MSTAR_IR_INPUT_DEVICE
  bool "IR input layer device"
  default n
  select VIDEO_IR
  help
    Use MStar IR driver as input layer device like keyboard,
    This depend on VIDEO_IR and will auto enable it.

config IR_SUPPLY_RNG
bool "Supply to random number generator device"
default n
help
    Supply to random number generator device

config MSTAR_IR_MULTIPLE_MODE
  bool "Support multiple protocol"
  default n
  help
    Support multiple protocol

config MSTAR_PM_SWIR
bool "Support PM receive SWIR decode"
default n
help
    Support PM receive SWIR decode

endif

config MSTAR_IR_GPIO_TOGGLE
  bool "Support gpio toggle when IR recieve"
  default n
  help
    Support IR GPIO

config ENABLE_CUSTOMER_IR_PATH
  bool "Enable Customer IR Path"
  default n
  help
    Replace IR header file.

config ENABLE_CUSTOMER_IR_PATH_STRING
  string "The IR header file you used"
  depends on ENABLE_CUSTOMER_IR_PATH
help
  Replace IR header file.
default IR_MSTAR_DTV.h
```

## mstar2/drv/ir_mirc/Kconfig
```kconfig
config MSTAR_IR_REFACTOR
	bool "Mstar IR Driver"
	default y
	help
		Mstar IR decoder driver function
menu "Mstar IR Config"
	depends on MSTAR_IR_REFACTOR
config IR_DYNAMIC_CONFIG
	tristate "load ir config(header,protocol,keymap) from /config/ir_config"
	default m
config MIRC_INPUT_DEVICE
	bool "IR Key send to input subsystem"
	default y
if MIRC_INPUT_DEVICE
source "drivers/mstar2/drv/ir_mirc/keymaps/Kconfig"
endif
endmenu
```

## mstar2/drv/ir_mirc/keymaps/Kconfig
```kconfig
menu "Mstar IR Keymap Select"
    depends on MIRC_INPUT_DEVICE
	config IR_KEYMAP_MSTAR_NEC
		tristate "Mstar NEC keymaps"
		default y
		help
		Mstar nec keymap
	config IR_KEYMAP_TCL_RCA
		tristate "TCL RCA keymaps"
		default y
		help
		TCL RCA keymaps
	config IR_KEYMAP_TCL
		tristate "TCL keymaps"
		default y
		help
		TCL tv keymaps
	config IR_KEYMAP_CHANGHONG
		tristate "Changhong IR keymaps"
		default y
		help
		Changhong tv keymaps
	config IR_KEYMAP_HISENSE
		tristate "Hisense IR keymaps"
		default y
		help
		Hisense tv keymaps
	config IR_KEYMAP_HAIER
		tristate "Haier IR keymaps"
		default y
		help
		Haier tv keymaps
	config IR_KEYMAP_KONKA
		tristate "Konka IR keymaps"
		default y
		help
		Konka tv keymaps
	config IR_KEYMAP_SKYWORTH
		tristate "Skyworth IR keymaps"
		default y
		help
		Skyworth tv keymaps
	config IR_KEYMAP_PANASONIC
		tristate "Pnasonic IR keymaps"
		default y
		help
		panasonic tv keymaps
	config IR_KEYMAP_KATHREIN
		tristate "Kathrein RC6 MODE_6A IR keymaps"
		default y
		help
		Kathrein tv keymaps
    config IR_KEYMAP_RC5
        tristate "RC5 IR keymaps"
        default y
        help
        RC5 tv keymaps
endmenu
```

## mstar2/drv/pcie/Kconfig
```kconfig
config MSTAR_PCIE

tristate "PCIE"
 
help
    MStar Host PCIE driver function
    
```

## mstar2/drv/pcie2/Kconfig
```kconfig
config MSTAR_PCIE2
	bool "MSTAR PCIE2"
	depends on PCI && (MSTAR_K7U_CA53 || MSTAR_K7U_CA7 || MSTAR_C2P)
	select MSTAR_IIC if MSTAR_ARM_BD_FPGA
	select MSTAR_GPIO if MSTAR_ARM_BD_FPGA
	help
	  Say Y here if you want the MStar PCIe host core. Select this if you are having a
	  problem with PCI support and want to see more of what is going on.

	  When in doubt, say N.
```

## mstar2/drv/rtc/Kconfig
```kconfig
config MSTAR_RTC

tristate "RTC"
#depends on WATCHDOG
default n 
help
    MStar Watchdog driver function
    
```

## mstar2/drv/tsensor/Kconfig
```kconfig
config MSTAR_TSENSOR

tristate "TSENSOR"

help
    MStar TSENSOR driver function
```

## mstar2/drv/vga_edid/Kconfig
```kconfig
config MSTAR_VGA_EDID
        tristate "VGA edid driver"
        help
          Say Y here to enable the driver for VGA edid  transmitter.

          If unsure, say Y.
```
