## arch/arm/mach-mstar/Kconfig
```kconfig
menuconfig ARCH_MSTAR
    bool "MStar ARM SoCs"

if ARCH_MSTAR
config ARCH_CEDRIC
    bool "SoC Cedric (ARCH_MULTI_V7)" if ARCH_MULTI_V7
    select SOC_BUS
    select ARM_GIC        
    select VFP
    select VFPv3

    help
      Support for Cedric SoC

config CEDRIC_MASTER0_ONLY_PATCH
    bool
    depends on ARCH_CEDRIC
    default y

config ARCH_CHICAGO
    bool "SoC Chicago (ARCH_MULTI_V7)" if ARCH_MULTI_V7
    select SOC_BUS       
    select VFP
    select VFPv3

    help
      Support for Chicago SoC

config ARCH_INFINITY
    bool "SoC iNfinity (ARCH_MULTI_V7)" if ARCH_MULTI_V7
    select SOC_BUS
    select ARM_GIC        
    select VFP
    select VFPv3
    select WIRELESS_EXT if WIRELESS && NET
    select WEXT_PRIV    if WIRELESS && NET
    select MULTIPLATFORM_XIP_CAPABLE
    help
      Support for iNfinity SoC

config ARCH_INFINITY3
    bool "SoC iNfinity3 (ARCH_MULTI_V7)" if ARCH_MULTI_V7
    select SOC_BUS
    select ARM_GIC        
    select VFP
    select VFPv3
    select WIRELESS_EXT if WIRELESS && NET
    select WEXT_PRIV    if WIRELESS && NET
    help
      Support for iNfinity3 SoC

config ARCH_INFINITY2
    bool "SoC iNfinity2 (ARCH_MULTI_V7)" if ARCH_MULTI_V7
    select SOC_BUS
    select ARM_GIC        
    select VFP
    select VFPv3
    select WIRELESS_EXT if WIRELESS && NET
    select WEXT_PRIV    if WIRELESS && NET
    select HAVE_ARM_SCU if SMP
    select ARM_GLOBAL_TIMER
    help
      Support for iNfinity2 SoC
comment "Options"
config MS_BUILTIN_DTB
    string "Builtin DTB"
    default ""

config MS_L2X0_PATCH
    bool "L2X0 patch"
    depends on CACHE_L2X0
    default y

config MS_DUAL_OS_SUPPORT
    bool "Dual OS support"
    default n

config MS_KERNEL_TYPE
	string 
	default ""
	
config MS_ARMV7_XIP
    bool
    default y
	depends on XIP_KERNEL

config MSTAR_CHIP_NAME
    string
    default "infinity2" if ARCH_INFINITY2
    default "infinity3" if ARCH_INFINITY3
    default "infinity" if ARCH_INFINITY
    default "chicago" if ARCH_CHICAGO

config MP_PLATFORM_ARM
	bool
	depends on CACHE_L2X0
	default y

endif
```

## drivers/mstar/Kconfig
```kconfig
source "drivers/mstar/irqchip/Kconfig"
source "drivers/mstar/clocksource/Kconfig"
source "drivers/mstar/msys/Kconfig"
source "drivers/mstar/serial/Kconfig"
source "drivers/mstar/clk/Kconfig"


if (ARCH_INFINITY) || (ARCH_INFINITY2) || (ARCH_INFINITY3)
source "drivers/mstar/isp/Kconfig"
endif

if (ARCH_CEDRIC) || (ARCH_INFINITY) || (ARCH_INFINITY3)
source "drivers/mstar/unfd/Kconfig"
endif

if (ARCH_CEDRIC) || (ARCH_CHICAGO) || (ARCH_INFINITY3) || (ARCH_INFINITY2)
source "drivers/mstar/emmc/Kconfig"
endif

if (ARCH_INFINITY) || (ARCH_INFINITY3) ||(ARCH_INFINITY2)
source "drivers/mstar/sdmmc/Kconfig"
endif

if (ARCH_CEDRIC) || (ARCH_CHICAGO) || (ARCH_INFINITY) || (ARCH_INFINITY3) ||(ARCH_INFINITY2)
source "drivers/mstar/sound/Kconfig"
endif


if (ARCH_CEDRIC) || (ARCH_CHICAGO) || (ARCH_INFINITY)
source "drivers/mstar/usb/Kconfig"
endif

if (ARCH_CEDRIC)
source "drivers/mstar/sca/Kconfig"
endif

if (ARCH_CEDRIC) || (ARCH_INFINITY) || (ARCH_INFINITY3) || (ARCH_INFINITY2)
source "drivers/mstar/dip/Kconfig"
endif

if (ARCH_CEDRIC) || (ARCH_CHICAGO) || (ARCH_INFINITY) || (ARCH_INFINITY3)
source "drivers/mstar/fb/Kconfig"
endif

if (ARCH_INFINITY3)
source "drivers/mstar/fb1/Kconfig"
endif

if (ARCH_INFINITY3)
source "drivers/mstar/fb2/Kconfig"
endif

if (ARCH_INFINITY2)
source "drivers/mstar/driver/drv/pnl/Kconfig"
endif

if (ARCH_INFINITY2)
source "drivers/mstar/driver/drv/mipi_dsi/Kconfig"
endif

#if (ARCH_INFINITY2)
#source "drivers/mstar/driver/drv/mload/Kconfig"
#endif

#if (ARCH_INFINITY2)
#source "drivers/mstar/gop/drv/Kconfig"
#endif

#if (ARCH_INFINITY2)
#source "drivers/mstar/cover/drv/Kconfig"
#endif

#if (ARCH_INFINITY2)
#source "drivers/mstar/rgn/MI_HAL/Kconfig"
#endif

#if (ARCH_INFINITY)|| (ARCH_INFINITY3)|| (ARCH_INFINITY2)
#source "drivers/mstar/scl/Kconfig"
#source "drivers/mstar/driver/drv/scl/Kconfig"
#endif

if (ARCH_INFINITY3) || (ARCH_INFINITY2)
source "drivers/mstar/driver/drv/mgwin/Kconfig"
endif

if (ARCH_INFINITY)  || (ARCH_INFINITY3) || (ARCH_INFINITY2)
source "drivers/mstar/emac/Kconfig"
endif


if (ARCH_CEDRIC) || (ARCH_INFINITY)|| (ARCH_INFINITY3)
source "drivers/mstar/ir/Kconfig"
endif

if (ARCH_CEDRIC) || (ARCH_INFINITY) || (ARCH_INFINITY3) || (ARCH_INFINITY2)
source "drivers/mstar/i2c/Kconfig"
endif

if (ARCH_CEDRIC) || (ARCH_INFINITY) || (ARCH_INFINITY3) || (ARCH_INFINITY2)
source "drivers/mstar/i2c_sw/Kconfig"
endif

if (ARCH_CEDRIC) || (ARCH_INFINITY) || (ARCH_INFINITY3) || (ARCH_INFINITY2)
source "drivers/mstar/gpio/Kconfig"
endif

if (ARCH_INFINITY)|| (ARCH_INFINITY3) || (ARCH_INFINITY2)
source "drivers/mstar/watchdog/Kconfig"
endif

if (ARCH_INFINITY)|| (ARCH_INFINITY3) || (ARCH_INFINITY2)
source "drivers/mstar/sar/Kconfig"
endif

if (ARCH_INFINITY)|| (ARCH_INFINITY3)
source "drivers/mstar/ircut/Kconfig"
endif

if (ARCH_INFINITY) || (ARCH_INFINITY3) || (ARCH_INFINITY2)
source "drivers/mstar/rtc/Kconfig"
endif

if (ARCH_CEDRIC) || (ARCH_CHICAGO) || (ARCH_INFINITY) || (ARCH_INFINITY3) || (ARCH_INFINITY2)
source "drivers/mstar/flash_isp/Kconfig"
endif

if (ARCH_INFINITY)|| (ARCH_INFINITY3)
source "drivers/mstar/xpm/Kconfig"
endif

if (ARCH_INFINITY)|| (ARCH_INFINITY3)
source "drivers/mstar/crypto/Kconfig"
endif

if (ARCH_INFINITY) || (ARCH_INFINITY3)
source "drivers/mstar/cpufreq/Kconfig"
endif

if (ARCH_INFINITY)|| (ARCH_INFINITY3) || (ARCH_INFINITY2)
source "drivers/mstar/pwm/Kconfig"
endif

if (ARCH_INFINITY)|| (ARCH_INFINITY3) || (ARCH_INFINITY2)
source "drivers/mstar/spinand/Kconfig"
endif

if (ARCH_INFINITY)|| (ARCH_INFINITY3) || (ARCH_INFINITY2)
source "drivers/mstar/spi/Kconfig"
endif

if (ARCH_INFINITY) || (ARCH_INFINITY3)
source "drivers/mstar/pm/Kconfig"
endif

if (ARCH_INFINITY2)
source "drivers/mstar/ive/Kconfig"
endif

if (ARCH_INFINITY3)
source "drivers/mstar/notify/Kconfig"
endif

if (ARCH_INFINITY2)
source "drivers/mstar/noe/Kconfig"
endif

if (ARCH_INFINITY2)
source "drivers/mstar/gmac/Kconfig"
endif

#if (ARCH_INFINITY2)
#source "drivers/mstar/vif/Kconfig"
#endif

if (ARCH_INFINITY2)
source "drivers/mstar/mma_heap/Kconfig"
endif

if (ARCH_INFINITY2)
source "drivers/mstar/miu/Kconfig"
endif

if (ARCH_INFINITY2)
source "drivers/mstar/sata_host/Kconfig"
endif

if (ARCH_INFINITY2)
source "drivers/mstar/warp/Kconfig"
endif

if (ARCH_INFINITY2)
source "drivers/mstar/ceva_linkdrv/Kconfig"
endif

if (ARCH_INFINITY2)
source "drivers/mstar/isrcb/Kconfig"
endif

menuconfig CAM_DRIVERS
    bool "MStar Cam drivers"
    depends on MSTAR_DRIVERS
    default n
if ( CAM_DRIVERS )
source "drivers/mstar/camdriver/Kconfig"
endif
```

## drivers/mstar/driver/drv/mgwin/Kconfig
```kconfig
config MS_MGWIN
	tristate "MGWIN driver"
	help
    		To enable MSTAR MGWIN driver.

config MS_MGWIN_INFINITY3
  tristate "support I3 driver"
	depends on MS_MGWIN
	depends on ARCH_INFINITY3

config MS_MGWIN_INFINITY2
  tristate "support I2 driver"
	depends on MS_MGWIN
	depends on ARCH_INFINITY2
```

## drivers/mstar/driver/drv/mipi_dsi/Kconfig
```kconfig
config MS_MIPI_TX_DSI
	tristate "MStar MIPI TX DSI driver"
	help
    		To enable MSTAR MIPI TX DSI driver function.
```

## drivers/mstar/driver/drv/mload/Kconfig
```kconfig
config MS_MLOAD
	tristate "MLOAD driver"
	help
    		To enable MSTAR MLOAD driver.
```

## drivers/mstar/driver/drv/pnl/Kconfig
```kconfig
config MS_PNL
	tristate "MStar LCD Panel TTL driver"
	help
    		To enable MSTAR LCD panel ttl driver function.
```

## drivers/mstar/emmc/Kconfig
```kconfig
config MS_EMMC
	bool "EMMC driver"
	depends on MMC
	help
    		To enable MSTAR EMMC driver.
    		
config MS_EMMC_CEDRIC
    tristate "EMMC support for Cedric"
    depends on MS_EMMC
    depends on ARCH_CEDRIC    		

    
config MS_EMMC_CHICAGO
    tristate "EMMC support for Chicago"
    depends on MS_EMMC
    depends on ARCH_CHICAGO
```

## drivers/mstar/gpio/Kconfig
```kconfig
config MS_GPIO
	tristate "GPIO driver"	
	default y
	help
	
config MS_GPIO_CEDRIC
    tristate "GPIO driver support for Cedric"
    depends on MS_GPIO    
    depends on ARCH_CEDRIC 		

config MS_GPIO_INFINITY
    tristate "GPIO driver support for iNfinity"
    depends on MS_GPIO        
    depends on ARCH_INFINITY    

config MS_SW_I2C_INFINITY
    tristate "SW I2C via GPIO support for iNfinity"
    depends on MS_GPIO_INFINITY
```

## drivers/mstar/ircut/Kconfig
```kconfig
config MS_IRCUT
        tristate "ircut driver"
	depends on ARCH_INFINITY
        help
          Say Y here to enable the driver for the ircut.

          If unsure, say Y.

          To compile this driver as a module, choose M here: the
          module will be called mdrv_ircut.
```

## drivers/mstar/isrcb/Kconfig
```kconfig
#config MS_ISRCB
#    boolean "Mstar ISRCB driver"
#    help
#        MStar ISRCB driver function

config MS_ISRCB_INFINITY2
    boolean "ISRCB driver support for iNfinity2"
    depends on ARCH_INFINITY2
```

## drivers/mstar/miu/Kconfig
```kconfig
config MSTAR_MIU

tristate "MSTAR MIU"

help
    MStar miu driver
default n
    
```

## drivers/mstar/noe/Kconfig
```kconfig
config MS_NOE
    bool "Mstar NOE driver"
    depends on ARCH_INFINITY2
    help
        MStar NOE driver function
menu "MStar Network Offload Engine"
source "drivers/mstar/noe/drv/eth/Kconfig"
if NETFILTER
config NOE_NAT_HW
    bool "HW NAT support (Module Mode Only)"
    depends on NOE
source "drivers/mstar/noe/drv/nat/hw_nat/Kconfig"
endif   # if NETFILTER
endmenu #"MStar Network Offload Engine"
```

## drivers/mstar/pm/Kconfig
```kconfig
config MS_PM
    tristate "Mstar PM driver"
    depends on ARCH_INFINITY
    help
```

## drivers/mstar/rtc/Kconfig
```kconfig
config MS_RTC
	bool "MS_RTC"
	default n
	help

config RTC_INNER
	select RTC_CLASS
	tristate "Mstar RTC driver"
	depends on MS_RTC
	default y
	help

config RTC_IT7C4337
	select RTC_CLASS
	tristate "IT7C4337 RTC driver"
	depends on MS_RTC
	default n
	help
```

## drivers/mstar/sata_host/Kconfig
```kconfig
config MS_SATA_HOST
    tristate "MStar SATA HOST"
    help
        MStar SATA Host driver function

config MS_SATA_BENCH_TEST
    tristate "Support SATA Bench test"
    depends on MS_SATA_HOST
    default n
```

## drivers/mstar/sca/Kconfig
```kconfig
config MS_SCALER
	tristate "Scaler driver"
	default y
	help

config MS_DUAL_SCREEN
bool "Support Dual Screen. And both screens display the same screen."
depends on MS_QST
	help
	If the device has two screen, And both screens display the same screen. Say Yes here.
	Otherwise Say No.

config MS_DUAL_SCREEN_HDMITX
bool "Support Dual Screen HDMITx. And both screens display the same screen."
depends on MS_QST
	help
	If the device has two screen, And both screens display the same screen. Say Yes here.
	Otherwise Say No.

config MS_CLONE_SCREEN
bool "Support Clone Screen. The secondary screen will be same as the primary screen."
depends on MS_SCALER
	help
	If the device has two screen, The secondary screen will be same as the primary screen. Say Yes here.
	Otherwise Say No.
	
config MS_SCALER_BOOT_PNL	
bool "Support scaler bootup pnl. The scaler will bootup pnl."
depends on MS_SCALER
	help
	If the device has two screen, The secondary screen will be same as the primary screen. Say Yes here.
	Otherwise Say No.
```

## drivers/mstar/sdmmc/Kconfig
```kconfig
config MS_SDMMC
	tristate "Mstar SD/MMC Card Interface Support"
	depends on MMC
	default n
  ---help---
        Enable SD/MMC Driver Support for MStar Product

config MS_SDMMC_REVCDZ
	bool "Mstar SD/MMC Reverse CDZ Pin"
	depends on MS_SDMMC
	default n
  ---help---
        For SD Socket Type, Revert the CDZ pin Value for Card Detection

config MS_SDMMC_TCARD
	bool "Mstar SD/MMC T-Flash Card Using"
	depends on MS_SDMMC
	default n
  ---help---
        For T-Flash Socket, We don't use WP Pin

config MS_SDMMC_REVWP
	bool "Mstar SD/MMC Reverse WP Pin"
	depends on !MS_SDMMC_TCARD && MS_SDMMC
	default n
  ---help---
        For SD Socket Type, Revert the WP pin Value for Write Protection

config MS_SDMMC_SECONDCARD
	bool "Mstar SD/MMC Second Cards Support"
	depends on MS_SDMMC
	default n
  ---help---
        Enable Second SD/MMC Card Interface
        
 config MS_SDMMC_THIRDCARD
	bool "Mstar SD/MMC Third Cards Support"
	depends on MS_SDMMC && MS_SDMMC_SECONDCARD
	default n
  ---help---
        Enable Third SD/MMC Card Interface       
       

config MS_SDMMC1_MAXCLK
    int "Mstar SD/MMC1 Maximum Clock"
	depends on MS_SDMMC
    default 32000000
    range 300000 50000000
  ---help---
      The maximun Clock of SDMMC1

config MS_SDMMC1_MAXDLVL
    int "Mstar SD/MMC1 Maximum DownLevel"
    depends on MS_SDMMC
    default 0
    range 0 5
    ---help---
      The maximun Clock Downgrade Level of SDMMC1

config MS_SDMMC1_PASSLVL
    int "Mstar SD/MMC1 Pass Level"
    depends on MS_SDMMC
    default 0
    range 0 5
    ---help---
      The maximun Clock Pass Level of SDMMC1

config MS_SDMMC1_HOTP
	bool "Mstar SD/MMC1 Hotplug Support"
	depends on MS_SDMMC
	default n
  ---help---
        For SD1, Whether we need to run hotplug funciton (HW consideration)

config MS_SDMMC1_FAKECDZ
	bool "Mstar SD/MMC1 Fake CDZ"
	depends on !MS_SDMMC1_HOTP && MS_SDMMC
	default n
  ---help---
        For SD1, Whether we need to assume card detection always true (HW consideration)        
        

config MS_SDMMC2_MAXCLK
    int "Mstar SD/MMC2 Maximum Clock"
    depends on MS_SDMMC_SECONDCARD
    default 32000000
    range 300000 50000000
    ---help---
      The maximun Clock of SDMMC2

config MS_SDMMC2_MAXDLVL
    int "Mstar SD/MMC2 Maximum DownLevel"
    depends on MS_SDMMC_SECONDCARD
    default 0
    range 0 5
    ---help---
      The maximun Clock Downgrade Level of SDMMC2
      
config MS_SDMMC2_PASSLVL
    int "Mstar SD/MMC2 Pass Level"
    depends on MS_SDMMC_SECONDCARD
    default 0
    range 0 5
    ---help---
      The maximun Clock Pass Level of SDMMC2
      
config MS_SDMMC2_HOTP
	bool "Mstar SD/MMC2 Hotplug Support"
	depends on MS_SDMMC_SECONDCARD
	default n
  ---help---
        For SD2, Whether we need to run hotplug funciton (HW consideration)

config MS_SDMMC2_FAKECDZ
	bool "Mstar SD/MMC2 Fake CDZ"
	depends on MS_SDMMC_SECONDCARD && !MS_SDMMC2_HOTP && MS_SDMMC
	default n
  ---help---
        For SD2, Whether we need to assume card detection always true (HW consideration)

config MS_SDMMC3_MAXCLK
    int "Mstar SD/MMC3 Maximum Clock"
    depends on MS_SDMMC_THIRDCARD
    default 32000000
    range 300000 50000000
    ---help---
      The maximun Clock of SDMMC3

config MS_SDMMC3_MAXDLVL
    int "Mstar SD/MMC3 Maximum DownLevel"
    depends on MS_SDMMC_THIRDCARD
    default 0
    range 0 5
    ---help---
      The maximun Clock Downgrade Level of SDMMC3
      
config MS_SDMMC3_PASSLVL
    int "Mstar SD/MMC3 Pass Level"
    depends on MS_SDMMC_THIRDCARD
    default 0
    range 0 5
    ---help---
      The maximun Clock Pass Level of SDMMC3
      
config MS_SDMMC3_HOTP
	bool "Mstar SD/MMC3 Hotplug Support"
	depends on MS_SDMMC_THIRDCARD
	default n
  ---help---
        For SD3, Whether we need to run hotplug funciton (HW consideration)

config MS_SDMMC3_FAKECDZ
	bool "Mstar SD/MMC3 Fake CDZ"
	depends on MS_SDMMC_THIRDCARD && !MS_SDMMC3_HOTP && MS_SDMMC
	default n
  ---help---
        For SD3, Whether we need to assume card detection always true (HW consideration)
```

## drivers/mstar/sound/Kconfig
```kconfig
menuconfig MS_SOUND
	tristate "Audio driver"
	select SOUND
	select SND
	select SND_SOC
	select SND_PCM
	help
	  Say Y or M if you want to add support for codecs attached to
	  the iNfinity2 Aduio driver.


config MS_SOUND_INFINITY2
    tristate "Audio support for iNfinity2"
    depends on MS_SOUND
    depends on ARCH_INFINITY2
```

## drivers/mstar/spi/Kconfig
```kconfig
config MS_SPI
    tristate "MS SPI driver"
    default n
    help
    Enable support for SPI Driver
```
